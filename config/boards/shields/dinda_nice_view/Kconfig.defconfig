## config/boards/shields/dinda_nice_view/Kconfig.defconfig
```kconfig
# Copyright (c) 2026
# SPDX-License-Identifier: MIT

if SHIELD_DINDA_NICE_VIEW

config LS0XX_VCOM_THREAD_PRIO
    default 11

config LV_Z_VDB_SIZE
    default 100

config LV_DPI_DEF
    default 161

config LV_Z_BITS_PER_PIXEL
    default 1

choice LV_COLOR_DEPTH
    default LV_COLOR_DEPTH_1
endchoice

choice ZMK_DISPLAY_WORK_QUEUE
    default ZMK_DISPLAY_WORK_QUEUE_DEDICATED
endchoice

choice ZMK_DISPLAY_STATUS_SCREEN
    default ZMK_DISPLAY_STATUS_SCREEN_CUSTOM
endchoice

config LV_Z_MEM_POOL_SIZE
    default 8192

config ZMK_DISPLAY_STATUS_SCREEN_CUSTOM
    imply DINDA_NICE_VIEW_WIDGET_STATUS

config DINDA_NICE_VIEW_WIDGET_STATUS
    bool "Dinda custom nice!view status widget"
    select LV_USE_CANVAS
    select LV_FONT_MONTSERRAT_18
    select LV_FONT_MONTSERRAT_16
    select LV_FONT_UNSCII_8
    select ZMK_WPM

config DINDA_NICE_VIEW_WIDGET_INVERTED
    bool "Invert Dinda custom status widget colors"

endif # SHIELD_DINDA_NICE_VIEW
```

## config/boards/shields/dinda_nice_view/Kconfig.shield
```kconfig
# Copyright (c) 2026
# SPDX-License-Identifier: MIT

config SHIELD_DINDA_NICE_VIEW
    def_bool $(shields_list_contains,dinda_nice_view)
```
